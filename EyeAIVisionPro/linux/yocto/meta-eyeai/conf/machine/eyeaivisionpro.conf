## EyeAIVisionPro/yocto/meta-eyeai/conf/distro/eyeaivision.conf
```bitbake
DISTRO = "eyeaivision"
DISTRO_NAME = "Linux distro for EyeAIVision Pro"
DISTRO_VERSION = "1.0"
MAINTAINER = "Thomas Fritzler <thomas_fritzler@web.de>"

# C library we want to use
TCLIBC = "glibc"

INIT_MANAGER = "mdev-busybox"

# Quality assurance checks
ERROR_QA:append = " textrel host-user-contaminated"
WARN_QA:append = " buildpaths ldflags"

hostname:pn-base-files = "eyeaivision"
```

## EyeAIVisionPro/yocto/meta-eyeai/conf/layer.conf
```bitbake
BBPATH .= ":${LAYERDIR}"

BBFILES += "${LAYERDIR}/recipes-*/*/*.bb \
            ${LAYERDIR}/recipes-*/*/*.bbappend"

BBFILE_COLLECTIONS += "meta-eyeai"
BBFILE_PATTERN_meta-eyeai = "^${LAYERDIR}/"
BBFILE_PRIORITY_meta-eyeai = "10"

LAYERDEPENDS_meta-eyeai = "core"
LAYERSERIES_COMPAT_meta-eyeai = "blacksail"
```
